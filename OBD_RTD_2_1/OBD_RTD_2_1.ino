/**
 * ALEX NEIMAN'S Neiman Mfg. Co (Neimdawg Industries) Real time diagnostics OBD Scan gauge tool.
 * 
 *      
 *      
 *      Z8L NNNN';NNNs qNNN.!NNNa SNNN,~NNNq INNN;'NNNA LNNN>`NNNR TNNNT RNNN`>NNNf ANNN';Nq 
 *    :@@^ ||||`'|||; =|||`'|||! !|||..|||+ ;|||'`|||+ ~|||, |||* ~|||~ *||| ,|||; +|||`a@Q 
 *    _!;                                                                               !!, 
 *    @@Y    !ii+    ,ii;  Liiiiii^ `ii|  `iiL      ;ii<      *ii=     .iiL`   `|ii    +@@' 
 *   'XD,    Q@@@J   X@@< ;@@@%%%%? |@@A  L@@@|    J@@@U     k@@@@.    7@@@R`  +@@B    ?Kw  
 *   IE?    !@@@@@j `@@@` h@@S      g@@^  Q@@@@` `D@@@@|   `%@Q<@@Y    Q@@@@N` d@@c   `6a,  
 *  `@@|    6@@jq@@wL@@m `@@@@@@@J ,@@Q  *@@b@@o~Q@%@@@'  ,Q@Q' Q@Q.  ~@@QL@@Q~@@@`   \@@`  
 *  '!^`   `@@@, K@@@@@; <@@Q,,,,` t@@5 `B@@'X@@@@o~@@Q  _Q@@BKK@@@z  y@@z i@@@@@d    ~!;   
 *  W@X    |@@k   k@@@Q  D@@#jjj{  Q@@_ c@@w 'EEE+ 7@@S ^@@Qiiiij@@Q  @@@.  <@@@@+   ,@@;   
 * `%Q!    |yy,    7yy+  yyyyyyyi .yyn  7yy'       ?yy~'yyy.     yyy''yy7    !yyy    >NN    
 * ^7^                                                                               zi,    
 *`Q@q` :::, .:::. ,::: .:::' ,::: `:::' ':::``:::' ':::` :::, ':::. :::: .:::` ,:::!@@,    
 *,Q@@L`@@@Q }@@@} Q@@@`i@@@w N@@@'^@@@a 6@@@;~@@@K K@@@='@@@N Z@@@T @@@@ J@@@L`Q@@@~aU
 *
 *
 */

// libraries
#include <SPI.h>
#include <mcp2515.h>
#include <Wire.h>
#include <Adafruit_GFX.h>
#include <Adafruit_SSD1306.h>

// misc placeholders
#define log_all_codes false
#define PID_RPM 0x0C
#define PID_OutsideTemp 0x46
#define PID_FuelTank 0x2F
#define PID_EngineLoad 0x04
#define PID_CoolantTemp 0x05
#define SCREEN_WIDTH 128
#define SCREEN_HEIGHT 32
#define OLED_RESET     4 // not sure what this is hahahaha
#define init_delay 3000 // duration that the startup screen is displayed.

// vanity placeholders
#define DEVICE_SERIAL_NUMBER "G0101"
#define DEVICE_NAME "OBD Scan Gauge Device"
#define HARDWARE_VERSION "Hw2.0"
#define DATE_OF_MFG "11/01/2020"
#define FIRMWARE_VERSION "2.0"
#define FIRMWARE_BUILD  "01"

// frame structures
struct can_frame canMsg;
struct can_frame canMsgOutgoing;

// create objects/init board
MCP2515 mcp2515(10);
Adafruit_SSD1306 display(SCREEN_WIDTH, SCREEN_HEIGHT, &Wire, OLED_RESET);

// timer vars
// max value of an unsigned long is ~2^32...this arduino will run for 50 days and then
// who knows what will happen when the millis() exceeds the max!
unsigned long last_rpm = 0;
unsigned long last_temp = 0;

// display coordinate calculation vars
int16_t xs1, ys1;
uint16_t w, h;

// data vars
int rpm = 9999;
int eng_temp = 999;
int consecutive_ms_button_pressed = 0;
int incoming_byte_serial[11];

 // 'OBD Logo 2 copy', 128x32px ALTERNATE Startup logo (second iteration)
const unsigned char bitmap [] PROGMEM = {
 0x55, 0x45, 0x55, 0x09, 0x22, 0xaa, 0xaa, 0xb6, 0xb7, 0xbd, 0x6a, 0xab, 0x7f, 0xed, 0xef, 0xf7, 
  0x00, 0x10, 0x22, 0xb2, 0xad, 0x55, 0x55, 0x6d, 0x6a, 0xd7, 0xbf, 0xfd, 0xf6, 0xff, 0xff, 0xff, 
  0x2a, 0xa5, 0x44, 0x44, 0x51, 0x2a, 0xaa, 0xca, 0xdd, 0xad, 0x55, 0x57, 0xaf, 0xb7, 0xbb, 0x7f, 
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  0x55, 0x24, 0x90, 0xa5, 0xaa, 0xa9, 0x55, 0x75, 0xb6, 0xd6, 0xbb, 0x7d, 0xff, 0xff, 0xff, 0xff
};

// 'priusoff', 128x32px
const unsigned char priusoff [] PROGMEM = {
  0x00, 0x00, 0x00, 0x00, 0x00, 0x00, 0x00, 0x00, 0x00, 0x00, 0x00, 0x00, 0x00, 0x00, 0x00, 0x00, 
  0x00, 0x00, 0x00, 0x00, 0x00, 0x00, 0x00, 0x00, 0x00, 0x00, 0x00, 0x00, 0x00, 0x00, 0x00, 0x00, 
  0x00, 0x00, 0x00, 0x00, 0x00, 0xc0, 0x00, 0x00, 0x00, 0x00, 0x00, 0x00, 0x07, 0xf8, 0x00, 0x00, 
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  0x00, 0x00, 0x00, 0x00, 0x00, 0x00, 0x00, 0x00, 0x00, 0x00, 0x00, 0x00, 0x00, 0x00, 0x00, 0x00
};



// icons. Rpm on left, temp on right.
const unsigned char icons [] PROGMEM = {
  0x43, 0xe0, 0x22, 0x00, 0x86, 0xb0, 0x53, 0x00, 0x48, 0x28, 0x02, 0x00, 0x18, 0x4c, 0x03, 0x00, 
  0x10, 0x44, 0x02, 0x00, 0x18, 0x8c, 0x07, 0x00, 0x10, 0x04, 0x97, 0x48, 0x18, 0x0c, 0x67, 0x30, 
  0x08, 0x08, 0x00, 0x00, 0x06, 0x30, 0x92, 0x48, 0x03, 0xe0, 0x6d, 0xb0
};


// function to request OBD data
void requestDataOBD(unsigned long int pid) {
  canMsgOutgoing.can_id  = 0x7DF;   // request
  canMsgOutgoing.can_dlc = 8;       // length of data frame
  canMsgOutgoing.data[0] = 0x02;    // ?
  canMsgOutgoing.data[1] = 0x01;    // ?
  canMsgOutgoing.data[2] = pid;    // OBD PID that we are requesting
  canMsgOutgoing.data[3] = 0x00;   // zeros
  canMsgOutgoing.data[4] = 0x00;
  canMsgOutgoing.data[5] = 0x00;
  canMsgOutgoing.data[6] = 0x00;
  canMsgOutgoing.data[7] = 0x00;
  mcp2515.sendMessage(&canMsgOutgoing);
}

void draw_temp_1() {
  // engine temp
  display.setTextSize(2);
  display.getTextBounds(String(eng_temp), 0, 0, &xs1, &ys1, &w, &h);
  display.setTextWrap(false);
  display.setCursor(130-w,0);
  if (eng_temp != 999) {
    display.print(eng_temp);
  }
}

void draw_ice_1() {
  // rpm number
  display.setTextSize(4);
  display.setTextColor(SSD1306_WHITE);
  display.getTextBounds(String(rpm), 0, 0, &xs1, &ys1, &w, &h);
  display.setCursor(96-w,0);
  display.cp437(true);
  display.print(rpm);
}

void init_screen_1() {
  display.clearDisplay();
  draw_ice_1();
  draw_temp_1();
  display.drawBitmap(98,16,icons,29,11,1);
  display.display();
}

void shut_down() {
  bool sleeping = true;
  consecutive_ms_button_pressed = 0;
  display.clearDisplay();
  display.drawBitmap(0, 0, priusoff, 128, 32, 1);
  display.display();
  delay(2000);
  display.clearDisplay();
  display.display();
  while (true);
  /*
  while (sleeping) {
    if (digitalRead(7)) {
      consecutive_ms_button_pressed++;
      if (consecutive_ms_button_pressed > 300) {
        // Turn display off
        sleeping = false;
        consecutive_ms_button_pressed = 0;
      }
    } else {
      consecutive_ms_button_pressed = 0;
    }
  }*/
}


 void setup() {
  // init screen
  if(!display.begin(SSD1306_SWITCHCAPVCC, 0x3C)) { // Address 0x3C for 128x32. Note: if your display does
    for(;;); //                                       not work, try an i2c scanner to find the correct addy.
  }
  display.clearDisplay();
  display.drawBitmap(0, 0, bitmap, 128, 32, 1);
  display.display();

  // init can board
  mcp2515.reset();
  mcp2515.setBitrate(CAN_1000KBPS); // Your vehicle may use a different speed!
  mcp2515.setNormalMode();

  // test to see if button pressed
  pinMode(8, OUTPUT);
  digitalWrite(8, HIGH);
  pinMode(7, INPUT);

  
  // wait for a second
  for (int x = 0; x < init_delay; x++) {
    delay(1);
    if (digitalRead(7)) {
      consecutive_ms_button_pressed++;
      if (consecutive_ms_button_pressed > 300) {
        // Turn display off
        shut_down();
      }
    }
  }

  
  init_screen_1();
  
  requestDataOBD(PID_CoolantTemp);

}

void loop() {

    if (digitalRead(7)) {
      consecutive_ms_button_pressed++;
      if (consecutive_ms_button_pressed > 3000) {
        // Turn display off
        shut_down();
      }
    } else {
      consecutive_ms_button_pressed = 0;
    }


  if (mcp2515.readMessage(&canMsg) == MCP2515::ERROR_OK) {
    
    if (canMsg.can_id == 0x7eA) { // response from ecu
  
      if (canMsg.data[2] == PID_CoolantTemp) { // Coolant
        
        eng_temp = (9.0*(canMsg.data[3] - 40)/5.0+32.0); // there are formulas for turning the data bytes
          display.setTextSize(2);                        // into actual "numbers". Look on wikipedia page
          display.getTextBounds(String(eng_temp), 0, 0, &xs1, &ys1, &w, &h);
          display.setTextWrap(false);
          display.fillRect(94,0,36,h,SSD1306_BLACK);
          display.setCursor(130-w,0);
          display.print(eng_temp);
          display.display();
        
      }
      if (canMsg.data[2] == PID_RPM) { // ICE RPM
        rpm = (canMsg.data[3]*256 + canMsg.data[4])/4; // same here. Some codes use more than one byte to store
                                                        // the svalue. The real RPM is a conjugate of two
        display.setTextSize(4);                         // bytes, [3] and [4].
        display.setTextColor(SSD1306_WHITE);
        display.getTextBounds(String(rpm), 0, 0, &xs1, &ys1, &w, &h);
        display.fillRect(0, 0, 94, h, SSD1306_BLACK);
        display.setCursor(96-w,0);
        display.cp437(true);
        display.print(rpm);
        display.display();
      }
      
    }

  }

    // "queue" data update requests
  if ((millis() - last_rpm) > 1430) { // change these values here to change the update frequency
    requestDataOBD(PID_RPM);
    // update counter
    last_rpm = millis();
  }
  if ((millis() - last_temp) > 9930) { // this one too
    requestDataOBD(PID_CoolantTemp);
    // update counter
    last_temp = millis();
  }
  
}
